## conf/distro/gnome-wayland.conf
```bitbake
require conf/distro/poky.conf

DISTRO = "gnome-wayland"
DISTRO_NAME = "Gnome (wayland)"
DISTRO_FEATURES_DEFAULT = " \
    acl \
    alsa \
    bluetooth \
    dbus \
    ext2 \
    gobject-introspection-data \
    gtk+3 \
    gtk4 \
    ipv4 \
    ipv6 \
    largefile \
    nfc \
    nfs \
    opengl \
    pam \
    pci \
    pcmcia \
    pipewire \
    polkit \
    pulseaudio \
    seccomp \
    systemd \
    tpm2 \
    usbgadget \
    usbhost \
    usrmerge \
    vfat \
    vulkan \
    wayland \
    wifi \
    x11 \
    xattr \
    xwayland \
    zeroconf \
"

WKS_FILE:x86-64 = "systemd-btrfs.wks.in"
WKS_FILE:rpi = "sdimage-raspberrypi.wks.in"
IMAGE_FSTYPES = "wic wic.bmap"

DISTRO_FEATURES_BACKFILL:remove = "pulseaudio gobject-introspection-data ldconfig"
DISTRO_FEATURES_BACKFILL_CONSIDERED = "sysvinit"
DISTRO_FEATURES:remove = "sysvinit"

VIRTUAL-RUNTIME_init_manager = "systemd"
VIRTUAL-RUNTIME_login_manager = "systemd"
VIRTUAL-RUNTIME_dev_manager = "systemd"
VIRTUAL-RUNTIME_initscripts = "systemd-compat-units"

# Ensure the kernel nfs server is enabled
KERNEL_FEATURES:append = " features/nfsd/nfsd-enable.scc"

# Replace busybox
PREFERRED_PROVIDER_virtual/base-utils = "coreutils"
VIRTUAL-RUNTIME_base-utils = "coreutils"
VIRTUAL-RUNTIME_base-utils-hwclock = "util-linux-hwclock"
VIRTUAL-RUNTIME_base-utils-syslog = ""

# System configuration
PIPEWIRE_SESSION_MANAGER = "wireplumber"
WIRELESS_DAEMON = "iwd"

# Overrides for meta-raspberrypi
PREFERRED_PROVIDER_ffmpeg = "ffmpeg"
PREFERRED_PROVIDER_libav = "ffmpeg"
PREFERRED_PROVIDER_libpostproc = "ffmpeg"

SERIAL_CONSOLES = ""
```

## conf/layer.conf
```bitbake
# We have a conf and classes directory, add to BBPATH
BBPATH .= ":${LAYERDIR}"

# We have recipes-* directories, add to BBFILES
BBFILES += "${LAYERDIR}/recipes-*/*/*.bb ${LAYERDIR}/recipes-*/*/*.bbappend"

BBFILE_COLLECTIONS += "gnome-image"
BBFILE_PATTERN_gnome-image = "^${LAYERDIR}/"
BBFILE_PRIORITY_gnome-image = "7"

# This should only be incremented on significant changes that will
# cause compatibility issues with other layers
LAYERVERSION_gnome-image = "1"
LAYERSERIES_COMPAT_gnome-image = "mickledore"
LAYERDEPENDS_gnome-image = "core"
```
